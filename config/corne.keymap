/*
 * Copyright (c) 2020 The ZMK Contributors
 *
 * SPDX-License-Identifier: MIT
 */

#include <behaviors.dtsi>
#include <dt-bindings/zmk/keys.h>
#include <dt-bindings/zmk/bt.h>

#define DEFAULT 0
#define LOWER   1
#define RAISE   2
#define STENO   3

/ {         
     behaviors {
          hm: homerow_mods {
                  compatible = "zmk,behavior-hold-tap";
                  label = "HOMEROW_MODS";
                  #binding-cells = <2>;
                  tapping-term-ms = <200>;
                  quick-tap-ms = <125>;
                  flavor = "tap-preferred";
                  bindings = <&kp>, <&kp>;
        };
};



};

/ {
        keymap {
                compatible = "zmk,keymap";

                default_layer {
// -----------------------------------------------------------------------------------------------------
// | |   Q   | W |    F    |    P     | B |      | J |    L    |    U    | Y | ' | |
// | |   A   | R | LCTRL/S | LSHFT/T  | G |      | M | RSHFT/N | RCTRL/E | I | O | |
// | | GUI/Z | X |    C    |    D     | V |      | K |    H    |    ,    | . | / | |
//               |         | LWR/BSPC | - |      | ; | LWR/SPC |         |
                        bindings = <
   &none &kp Q      &kp W &kp F       &kp P       &kp B          &kp J    &kp L       &kp U       &kp Y   &kp APOS &none
   &none &kp A      &kp R &hm LCTRL S &hm LSHFT T &kp G          &kp M    &hm RSHFT N &hm RCTRL E &kp I   &kp O    &none
   &none &mt LGUI Z &kp X &kp C       &kp D       &kp V          &kp K    &kp H       &kp COMMA   &kp DOT &kp FSLH &none
                          &none       &lt 1 BSPC  &kp MINUS      &kp SEMI &lt 1 SPACE &none
                        >;
                };
                
                lower_layer {
// ----------------------------------------------------------------------
// | |  |   |  \  |   (   |   )   | DEL  |      |  -  | 7 | 8 | 9 | + | |
// | | LALT | TAB | LCTRL | LSHFT | ENT  |      |  ,  | 4 | 5 | 6 | . | |
// | |  {   |  }  |   [   |   ]   | ESC  |      |  /  | 1 | 2 | 3 | = | |
//                |       | BSPC  | CAPS |      | SPC | 0 |   |
                        bindings = <
   &none &kp PIPE &kp BSLH &kp LPAR  &kp RPAR  &kp DEL        &kp MINUS &kp N7 &kp N8 &kp N9 &kp PLUS  &none
   &none &kp LALT &kp TAB  &kp LCTRL &kp LSHFT &kp RET        &kp COMMA &kp N4 &kp N5 &kp N6 &lt 2 DOT &none
   &none &kp LBRC &kp RBRC &kp LBKT  &kp RBKT  &kp ESC        &kp FSLH  &kp N1 &kp N2 &kp N3 &kp EQUAL &none
                           &none     &kp BSPC  &kp CAPS       &kp SPACE &kp N0 &none
                        >;
                };
                
                raise_layer {
// --------------------------------------------------------------------------------------
// | | BTCLR | BT1 |  BT2  |  BT3  | DEL |      | STENO |       |  UP  |       |  | |
// | | LALT  | TAB | LCTRL | LSHFT | ENT |      |       | LEFT  | DOWN | RIGHT |  | |
// | |       |     |       |       | ESC |      |       |       |      |       |  | |
//                 |       |  BSPC |     |      |       | SPACE |      |
                        bindings = <
   &none &bt BT_CLR &bt BT_SEL 0  &bt BT_SEL 1 &bt BT_SEL 2 &kp DEL      &to 3 &none     &kp UP   &none     &none  &none
   &none &kp LALT   &kp TAB       &kp LCTRL    &kp LSHFT    &kp RET      &none &kp LEFT  &kp DOWN &kp RIGHT &trans &none
   &none &none      &none         &none        &none        &kp ESC      &none &none     &none    &none     &none  &none
                    	         &none        &kp BSPC     &none        &none &kp SPACE &none
                        >;
                };
                
                steno_layer {
// --------------------------------------------------------------------------------------
// | | 1 | 1 | 1 | 1 | DFL |      | 1 | 1 | 1 | 1 | 1 | |
// | | Q | W | E | R |  T  |      | U | I | O | P | [ | |
// | | A | S | D | F |  G  |      | J | K | L | ; | ' | |
//           |   | C |  V  |      | N | M |   |
                        bindings = <
   &none &kp N1 &kp N1 &kp N1 &kp N1 &to 0      &kp N1 &kp N1 &kp N1 &kp N1   &kp N1   &none
   &none &kp Q  &kp W  &kp E  &kp R  &kp T      &kp U  &kp I  &kp O  &kp P    &kp LBKT &none
   &none &kp A  &kp S  &kp D  &kp F  &kp G      &kp J  &kp K  &kp L  &kp SEMI &kp APOS &none
                       &none  &kp C  &kp V      &kp N  &kp M  &none
                        >;
                };
        };
};
                        >;
                };

                raise_layer {
// ----------------------------------------------------------------------------------------
// | | | | | | | | | | | | | |
// | | | | | | | | | | | | | |
// | | | | | | | | | | | | | |
//       | | | | | | | |
                        bindings = <
   & & & & & & & & & & & &
   & & & & & & & & & & & &
   & & & & & & & & & & & & 
   & & & & & & 
                        >;
                };
        };
};
